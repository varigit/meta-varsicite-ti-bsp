## conf/layer.conf
```bitbake
# We have a conf and classes directory, add to BBPATH
BBPATH .= ":${LAYERDIR}"

# We have a packages directory, add to BBFILES
BBFILES += "${LAYERDIR}/recipes-*/*/*.bb \
            ${LAYERDIR}/recipes-*/*/*.bbappend"

BBFILE_COLLECTIONS += "variscite-ti-bsp"
BBFILE_PATTERN_variscite-ti-bsp:= "^${LAYERDIR}/"
BBFILE_PRIORITY_variscite-ti-bsp= "16"

LAYERSERIES_COMPAT_variscite-ti-bsp= "dunfell"
```

## conf/machine/am335x-var-som.conf
```bitbake
#@TYPE: Machine
#@NAME: Variscite VAR-SOM-AM33
#@DESCRIPTION: Machine configuration for the Variscite VAR-SOM-AM33 EVK
#@MAINTAINER: Pierluigi Passaro <pierluigi.p@variscite.com>

MACHINEOVERRIDES =. "am335x-evm:"
require conf/machine/include/ti33x.inc
require variscite.inc
require variscite_wl18xx.inc

MACHINE_FEATURES += "touchscreen"

UBOOT_ARCH = "arm"
UBOOT_MACHINE = ""
UBOOT_CONFIG ??= "nand sd "
# Last config in the list is default
UBOOT_CONFIG[nand] = "am335x_var_som_nand_defconfig"
UBOOT_CONFIG[sd] = "am335x_var_som_sd_defconfig"

KERNEL_DEVICETREE = "var-som-am33.dtb"
KERNEL_IMAGETYPES = "zImage"

IMAGE_FSTYPES += "ubi"

# VAR-SOM-AM33 EVK uses ttyS0
SERIAL_CONSOLES = "115200;ttyS0"
SERIAL_CONSOLES_CHECK = "${SERIAL_CONSOLES}"

# UBI information.  Note that this is board and kernel specific.  Changes
# in your kernel port may require changes in these variables.  For more
# details about this board please see
# http://processors.wiki.ti.com/index.php/UBIFS_Support

# do ubiattach /dev/ubi_ctrl -m 7 -O 2048
# From dmesg:
# UBI: smallest flash I/O unit:    2048
# UBI: logical eraseblock size:    126976 bytes
# from ubiattach stdout:
# UBI device number 0, total 1988 LEBs
MKUBIFS_ARGS:am335x-var-som = "-F -m 2048 -e 126976 -c 4600"

# do ubiattach /dev/ubi_ctrl -m 7 -O 2048
# from dmesg:
# UBI: smallest flash I/O unit:    2048
# UBI: physical eraseblock size:   131072 bytes (128 KiB)
# UBI: sub-page size:              512
# UBI: VID header offset:          2048 (aligned 2048)
UBINIZE_ARGS:am335x-var-som = "-m 2048 -p 128KiB -s 512 -O 2048"
```

## conf/machine/am62x-var-som-k3r5-gp.conf
```bitbake
#@TYPE: Machine
#@NAME: VAR-SOM-AM62 (R5F)
#@DESCRIPTION: Machine configuration for the Variscite VAR-SOM-AM62 EVK (R5F core)
#@MAINTAINER: Nate Drude <nate.d@variscite.com>

MACHINEOVERRIDES =. "am62xx-evm-k3r5-gp:"
require conf/machine/include/k3r5.inc

SYSFW_SOC = "am62x"
SYSFW_CONFIG = "evm"
SYSFW_SUFFIX = "gp"

SYSFW_TIBOOT3_SYMLINK = ""

UBOOT_MACHINE = "am62x_var_som_r5_defconfig"

SPL_BINARY = ""
UBOOT_BINARY = "u-boot-spl.${UBOOT_SUFFIX}"
UBOOT_IMAGE = "u-boot-r5spl-gp-${MAINMACHINE}-${PV}-${PR}.${UBOOT_SUFFIX}"
UBOOT_SYMLINK = "u-boot-r5spl-gp.${UBOOT_SUFFIX}"

PREFERRED_RPROVIDER_u-boot-default-env ?= "u-boot-variscite"
PREFERRED_PROVIDER_virtual/bootloader = "u-boot-variscite"
PREFERRED_PROVIDER_u-boot = "u-boot-variscite"
```

## conf/machine/am62x-var-som-k3r5-hs-fs.conf
```bitbake
#@TYPE: Machine
#@NAME: VAR-SOM-AM62 HS-FS EVM (R5F)
#@DESCRIPTION: Machine configuration for the Variscite VAR-SOM-AM62 HS-FS EVM (R5F core)

# Booting HS-FS requires different SYSFW, the rest is handled at runtime

MACHINEOVERRIDES =. "am62xx-evm-k3r5-hs-fs:"
require conf/machine/include/k3r5.inc
SOC_FAMILY_append = ":k3r5-hs-fs"

SYSFW_SOC = "am62x"
SYSFW_CONFIG = "evm"
SYSFW_SUFFIX = "hs-fs"

UBOOT_MACHINE = "am62x_var_som_r5_defconfig"

PREFERRED_RPROVIDER_u-boot-default-env ?= "u-boot-variscite"
PREFERRED_PROVIDER_virtual/bootloader = "u-boot-variscite"
PREFERRED_PROVIDER_u-boot = "u-boot-variscite"
```

## conf/machine/am62x-var-som.conf
```bitbake
#@TYPE: Machine
#@NAME: Variscite VAR-SOM-AM62
#@DESCRIPTION: Machine configuration for the Variscite VAR-SOM-AM62 EVK
#@MAINTAINER: Nate Drude <nate.d@variscite.com>

MACHINEOVERRIDES =. "am62xx-evm:"
require conf/machine/include/am62xx.inc
require variscite.inc
require variscite_bcm43xx.inc

MACHINE_FEATURES += "gpu"

KERNEL_DEVICETREE = " \
    ti/k3-am625-var-som-symphony.dtb \
"

SPL_BINARY = "tispl.bin"
UBOOT_BINARY = "u-boot.img"
UBOOT_SYMLINK = "u-boot.img"
UBOOT_MACHINE = "am62x_var_som_a53_defconfig"

WKS_FILE = "var-sdimage-2part.wks"

# We have to disable SERIAL_CONSOLE due to auto-serial-console
SERIAL_CONSOLES = "115200;ttyS0"

# Enable virtualization
DISTRO_FEATURES:append = " virtualization"

# Add hs-fs binary to boot partition
IMAGE_BOOT_FILES += " tiboot3-am62x-hs-fs-evm.bin"
```

## wic/var-sdimage-2part.wks
```
# short-description: Create SD card image with 2 partitions
# long-description: Creates a partitioned SD card image for Variscite TI based platforms.
# Boot files are located in the first vfat partition with extra reserved space.
# Rootfs partition starts at offset 135M to allow room for U-Boot environment.

part /boot --source bootimg-partition --ondisk mmcblk0 --fstype=vfat --label boot --active --align 1024 --fixed-size 128M --use-uuid
part / --source rootfs --ondisk mmcblk0 --fstype=ext4 --label root --align 1024 --use-uuid --offset 135M
```
